## Config.in
```kconfig
menu "nuubOS"

source "$BR2_EXTERNAL_NUUBOS_PATH/package/nuubos/labwc/Config.in"
source "$BR2_EXTERNAL_NUUBOS_PATH/package/nuubos/nuubos-splash/Config.in"
source "$BR2_EXTERNAL_NUUBOS_PATH/package/nuubos/nuubos-notify/Config.in"
source "$BR2_EXTERNAL_NUUBOS_PATH/package/nuubos/nuubos-status/Config.in"
source "$BR2_EXTERNAL_NUUBOS_PATH/package/nuubos/nuubos-users/Config.in"
source "$BR2_EXTERNAL_NUUBOS_PATH/package/nuubos/nuubos-library/Config.in"
source "$BR2_EXTERNAL_NUUBOS_PATH/package/nuubos/nuubos-emulation/Config.in"
source "$BR2_EXTERNAL_NUUBOS_PATH/package/nuubos/nuubos-streaming/Config.in"
source "$BR2_EXTERNAL_NUUBOS_PATH/package/nuubos/nuubos-regional/Config.in"
source "$BR2_EXTERNAL_NUUBOS_PATH/package/nuubos/nuubos-localization/Config.in"
source "$BR2_EXTERNAL_NUUBOS_PATH/package/nuubos/nuubos-wifi/Config.in"
source "$BR2_EXTERNAL_NUUBOS_PATH/package/nuubos/nuubos-bluetooth/Config.in"
source "$BR2_EXTERNAL_NUUBOS_PATH/package/nuubos/nuubos-sftp-server/Config.in"
source "$BR2_EXTERNAL_NUUBOS_PATH/package/nuubos/nuubui-home/Config.in"
source "$BR2_EXTERNAL_NUUBOS_PATH/package/nuubos/nuubos-input/Config.in"
source "$BR2_EXTERNAL_NUUBOS_PATH/package/nuubos/nuubos-controllers/Config.in"
source "$BR2_EXTERNAL_NUUBOS_PATH/package/nuubos/nuubos-rumble/Config.in"
source "$BR2_EXTERNAL_NUUBOS_PATH/package/nuubos/nuubos-lighting/Config.in"
source "$BR2_EXTERNAL_NUUBOS_PATH/package/nuubos/nuubos-quick-menu/Config.in"
source "$BR2_EXTERNAL_NUUBOS_PATH/package/nuubos/nuubos-rgb/Config.in"
source "$BR2_EXTERNAL_NUUBOS_PATH/package/nuubos/nuubos-displayd/Config.in"
source "$BR2_EXTERNAL_NUUBOS_PATH/package/nuubos/nuubos-audio/Config.in"
source "$BR2_EXTERNAL_NUUBOS_PATH/package/nuubos/nuubos-home-music/Config.in"
source "$BR2_EXTERNAL_NUUBOS_PATH/package/nuubos/nuubos-system/Config.in"
source "$BR2_EXTERNAL_NUUBOS_PATH/package/nuubos/nuubos-recovery/Config.in"
source "$BR2_EXTERNAL_NUUBOS_PATH/package/nuubos/nuubos-jobs/Config.in"
source "$BR2_EXTERNAL_NUUBOS_PATH/package/nuubos/nuubos-scraper/Config.in"
source "$BR2_EXTERNAL_NUUBOS_PATH/package/nuubos/nuubos-remote/Config.in"
source "$BR2_EXTERNAL_NUUBOS_PATH/package/nuubos/nuubos-files/Config.in"
source "$BR2_EXTERNAL_NUUBOS_PATH/package/nuubos/nuubos-themes/Config.in"
source "$BR2_EXTERNAL_NUUBOS_PATH/package/nuubos/nuubos-update/Config.in"
source "$BR2_EXTERNAL_NUUBOS_PATH/package/nuubos/nuubos-media/Config.in"
source "$BR2_EXTERNAL_NUUBOS_PATH/package/nuubos/nuubos-sync/Config.in"
source "$BR2_EXTERNAL_NUUBOS_PATH/package/nuubos/nuubos-web/Config.in"

source "$BR2_EXTERNAL_NUUBOS_PATH/package/libretro/Config.in"
source "$BR2_EXTERNAL_NUUBOS_PATH/package/streaming/Config.in"
source "$BR2_EXTERNAL_NUUBOS_PATH/package/thirdparty/syncthing/Config.in"
source "$BR2_EXTERNAL_NUUBOS_PATH/package/thirdparty/skyscraper/Config.in"

endmenu
```

## configs/nuubos_rg35xx_pro_defconfig
```kconfig
BR2_aarch64=y
BR2_KERNEL_HEADERS_AS_KERNEL=y
BR2_PACKAGE_HOST_LINUX_HEADERS_CUSTOM_7_1=y
BR2_CCACHE=y
BR2_TARGET_GENERIC_HOSTNAME="nuubos"
BR2_TARGET_GENERIC_ISSUE="nuubOS early bring-up"
BR2_TARGET_GENERIC_GETTY_PORT="ttyS0"
BR2_TARGET_GENERIC_GETTY_BAUDRATE_115200=y
BR2_LINUX_KERNEL=y
BR2_LINUX_KERNEL_CUSTOM_VERSION=y
BR2_LINUX_KERNEL_CUSTOM_VERSION_VALUE="7.2.8"
BR2_LINUX_KERNEL_PATCH="$(BR2_EXTERNAL_NUUBOS_PATH)/patches/linux/h700 $(BR2_EXTERNAL_NUUBOS_PATH)/patches/linux/device/rg35xx-pro"
BR2_LINUX_KERNEL_USE_CUSTOM_CONFIG=y
BR2_LINUX_KERNEL_CUSTOM_CONFIG_FILE="$(BR2_EXTERNAL_NUUBOS_PATH)/board/nuubos/platform/h700/linux.config"
BR2_LINUX_KERNEL_DTS_SUPPORT=y
BR2_LINUX_KERNEL_INTREE_DTS_NAME="allwinner/sun50i-h700-anbernic-rg-sp allwinner/sun50i-h700-anbernic-rg28xx allwinner/sun50i-h700-anbernic-rg34xx allwinner/sun50i-h700-anbernic-rg34xx-sp allwinner/sun50i-h700-anbernic-rg34xx-sp-v2-panel allwinner/sun50i-h700-anbernic-rg35xx-2024 allwinner/sun50i-h700-anbernic-rg35xx-2024-rev6-panel allwinner/sun50i-h700-anbernic-rg35xx-h allwinner/sun50i-h700-anbernic-rg35xx-h-rev6-panel allwinner/sun50i-h700-anbernic-rg35xx-plus allwinner/sun50i-h700-anbernic-rg35xx-plus-rev6-panel allwinner/sun50i-h700-anbernic-rg35xx-pro allwinner/sun50i-h700-anbernic-rg35xx-sp allwinner/sun50i-h700-anbernic-rg35xx-sp-v2-panel allwinner/sun50i-h700-anbernic-rg40xx-h allwinner/sun50i-h700-anbernic-rg40xx-h-v2-panel allwinner/sun50i-h700-anbernic-rg40xx-v allwinner/sun50i-h700-anbernic-rg40xx-v-v2-panel allwinner/sun50i-h700-anbernic-rgcubexx"
BR2_LINUX_KERNEL_NEEDS_HOST_OPENSSL=y
BR2_TARGET_ROOTFS_EXT2=y
BR2_TARGET_ROOTFS_EXT2_4=y
# BR2_TARGET_ROOTFS_TAR is not set

BR2_TARGET_ARM_TRUSTED_FIRMWARE=y
BR2_TARGET_ARM_TRUSTED_FIRMWARE_CUSTOM_VERSION=y
BR2_TARGET_ARM_TRUSTED_FIRMWARE_CUSTOM_VERSION_VALUE="v2.15.0"
BR2_TARGET_ARM_TRUSTED_FIRMWARE_PLATFORM="sun50i_h616"

BR2_TARGET_UBOOT=y
BR2_TARGET_UBOOT_BUILD_SYSTEM_KCONFIG=y
BR2_TARGET_UBOOT_CUSTOM_VERSION=y
BR2_TARGET_UBOOT_CUSTOM_VERSION_VALUE="2026.07"
BR2_TARGET_UBOOT_BOARD_DEFCONFIG="anbernic_rg35xx_h700"
BR2_TARGET_UBOOT_NEEDS_DTC=y
BR2_TARGET_UBOOT_NEEDS_PYLIBFDT=y
BR2_TARGET_UBOOT_NEEDS_OPENSSL=y
BR2_TARGET_UBOOT_NEEDS_ATF_BL31=y
BR2_TARGET_UBOOT_SPL=y
BR2_TARGET_UBOOT_SPL_NAME="u-boot-sunxi-with-spl.bin"
BR2_TARGET_UBOOT_CUSTOM_MAKEOPTS="SCP=/dev/null"
BR2_TARGET_UBOOT_PATCH="$(BR2_EXTERNAL_NUUBOS_PATH)/patches/u-boot/platform/h700"
BR2_TARGET_UBOOT_CONFIG_FRAGMENT_FILES="$(BR2_EXTERNAL_NUUBOS_PATH)/board/nuubos/platform/h700/uboot.fragment"

BR2_PACKAGE_WPA_SUPPLICANT=y
BR2_PACKAGE_WPA_SUPPLICANT_CLI=y
BR2_PACKAGE_DROPBEAR=y
BR2_PACKAGE_DROPBEAR_DISABLE_REVERSEDNS=y

# Dropbear remains the only SSH daemon. OpenSSH is used only as the
# build provider for /usr/libexec/sftp-server.
BR2_PACKAGE_OPENSSH=y
# BR2_PACKAGE_OPENSSH_CLIENT is not set
# BR2_PACKAGE_OPENSSH_SERVER is not set
# BR2_PACKAGE_OPENSSH_KEY_UTILS is not set
# BR2_PACKAGE_OPENSSH_SANDBOX is not set
BR2_PACKAGE_NUUBOS_SFTP_SERVER=y
BR2_PACKAGE_LINUX_FIRMWARE=y
BR2_PACKAGE_LINUX_FIRMWARE_RTL_RTW88=y
BR2_PACKAGE_LINUX_FIRMWARE_RTL_88XX_BT=y
BR2_ROOTFS_OVERLAY="$(BR2_EXTERNAL_NUUBOS_PATH)/board/nuubos/common/rootfs-overlay $(BR2_EXTERNAL_NUUBOS_PATH)/board/nuubos/platform/h700/rootfs-overlay $(BR2_EXTERNAL_NUUBOS_PATH)/board/nuubos/device/rg35xx-pro/rootfs-overlay"
BR2_ROOTFS_POST_BUILD_SCRIPT="$(BR2_EXTERNAL_NUUBOS_PATH)/board/nuubos/common/post-build.sh"

BR2_PACKAGE_EXFATPROGS=y
BR2_PACKAGE_UTIL_LINUX=y
BR2_PACKAGE_UTIL_LINUX_BINARIES=y
BR2_PACKAGE_HOST_GENIMAGE=y
BR2_PACKAGE_HOST_MTOOLS=y
BR2_PACKAGE_HOST_DOSFSTOOLS=y
BR2_ROOTFS_POST_IMAGE_SCRIPT="$(BR2_EXTERNAL_NUUBOS_PATH)/board/nuubos/common/post-image.sh support/scripts/genimage.sh"
BR2_ROOTFS_POST_SCRIPT_ARGS="-c $(BR2_EXTERNAL_NUUBOS_PATH)/board/nuubos/platform/h700/genimage.cfg"
BR2_LINUX_KERNEL_INSTALL_TARGET=y
BR2_TARGET_ROOTFS_EXT2_SIZE="2G"
BR2_PACKAGE_BASH=y
BR2_PACKAGE_IW=y
BR2_PACKAGE_WIRELESS_REGDB=y
BR2_PACKAGE_BUSYBOX_SHOW_OTHERS=y

# DRM/KMS userspace
BR2_PACKAGE_LIBDRM=y

# GPU userspace - Mesa/Panfrost
BR2_TOOLCHAIN_BUILDROOT_CXX=y
BR2_PACKAGE_MESA3D=y
BR2_PACKAGE_MESA3D_GALLIUM_DRIVER_PANFROST=y
BR2_PACKAGE_MESA3D_OPENGL_EGL=y
BR2_PACKAGE_MESA3D_OPENGL_ES=y
BR2_GLOBAL_PATCH_DIR="$(BR2_EXTERNAL_NUUBOS_PATH)/patches/packages"
BR2_CCACHE_DIR="$(HOME)/.cache/nuubos/buildroot-ccache"

# ALSA userspace utilities
BR2_PACKAGE_ALSA_UTILS=y
BR2_PACKAGE_ALSA_UTILS_AMIXER=y
BR2_PACKAGE_ALSA_UTILS_APLAY=y
BR2_PACKAGE_ALSA_UTILS_SPEAKER_TEST=y

# V4L2/Cedrus diagnostics
BR2_PACKAGE_LIBV4L=y
BR2_PACKAGE_LIBV4L_UTILS=y

# Audio application proxy / graph (candidate runtime)
BR2_PACKAGE_PIPEWIRE=y
BR2_PACKAGE_LUA=y
BR2_PACKAGE_LUA_5_4=y
BR2_PACKAGE_WIREPLUMBER=y

# Bluetooth userspace
BR2_PACKAGE_BLUEZ5_UTILS=y
BR2_PACKAGE_BLUEZ_ALSA=y
BR2_PACKAGE_BLUEZ5_UTILS_PLUGINS_AUDIO=y
BR2_PACKAGE_BLUEZ5_UTILS_CLIENT=y
BR2_PACKAGE_BLUEZ5_UTILS_PLUGINS_HID=y
# BR2_PACKAGE_BLUEZ5_UTILS_PLUGINS_NETWORK is not set
BR2_PACKAGE_UTIL_LINUX_PARTX=y

# Wayland / UI placeholder stack
BR2_PACKAGE_WAYLAND=y
BR2_PACKAGE_WAYLAND_PROTOCOLS=y
BR2_PACKAGE_LIBXKBCOMMON=y
BR2_PACKAGE_SEATD=y
BR2_PACKAGE_WLROOTS=y
BR2_PACKAGE_LABWC=y
BR2_PACKAGE_WLR_RANDR=y
BR2_PACKAGE_HWDATA=y
BR2_PACKAGE_HWDATA_PNP_IDS=y
BR2_PACKAGE_FONTCONFIG=y
BR2_PACKAGE_DEJAVU=y
BR2_PACKAGE_HOST_RUSTC=y
BR2_PACKAGE_HOST_CARGO=y

BR2_PACKAGE_RSYNC=y
BR2_PACKAGE_BUSYBOX_CONFIG_FRAGMENT_FILES="$(BR2_EXTERNAL_NUUBOS_PATH)/board/nuubos/common/busybox-ntp.config"
BR2_PACKAGE_NUUBOS_RGB=y
BR2_PACKAGE_NUUBOS_DISPLAYD=y
BR2_PACKAGE_NUUBOS_AUDIO=y
BR2_PACKAGE_NUUBOS_HOME_MUSIC=y
BR2_PACKAGE_NUUBOS_SPLASH=y
BR2_PACKAGE_NUUBOS_NOTIFY=y
BR2_PACKAGE_NUUBOS_STATUS=y
BR2_PACKAGE_NUUBOS_WIFI=y
BR2_PACKAGE_NUUBOS_BLUETOOTH=y
BR2_PACKAGE_NUUBUI_HOME=y


BR2_PACKAGE_CAIRO_PNG=y
BR2_ROOTFS_DEVICE_CREATION_DYNAMIC_EUDEV=y
BR2_PACKAGE_EUDEV=y

BR2_PACKAGE_NUUBOS_INPUT=y
BR2_PACKAGE_NUUBOS_CONTROLLERS=y
BR2_PACKAGE_NUUBOS_RUMBLE=y
BR2_PACKAGE_NUUBOS_LIGHTING=y
BR2_PACKAGE_NUUBOS_QUICK_MENU=y

BR2_PACKAGE_NUUBOS_SYSTEM=y
```

## package/libretro/Config.in
```kconfig
menu "libretro (RetroArch backend and qualified H700 cores)"

source "$BR2_EXTERNAL_NUUBOS_PATH/package/libretro/retroarch/Config.in"
source "$BR2_EXTERNAL_NUUBOS_PATH/package/libretro/retroarch-assets/Config.in"
source "$BR2_EXTERNAL_NUUBOS_PATH/package/libretro/libretro-core-info/Config.in"
source "$BR2_EXTERNAL_NUUBOS_PATH/package/libretro/libretro-fceumm/Config.in"
source "$BR2_EXTERNAL_NUUBOS_PATH/package/libretro/libretro-snes9x/Config.in"
source "$BR2_EXTERNAL_NUUBOS_PATH/package/libretro/libretro-gambatte/Config.in"
source "$BR2_EXTERNAL_NUUBOS_PATH/package/libretro/libretro-mgba/Config.in"
source "$BR2_EXTERNAL_NUUBOS_PATH/package/libretro/libretro-pcsx-rearmed/Config.in"
source "$BR2_EXTERNAL_NUUBOS_PATH/package/libretro/libretro-genesis-plus-gx/Config.in"
source "$BR2_EXTERNAL_NUUBOS_PATH/package/libretro/libretro-picodrive/Config.in"
source "$BR2_EXTERNAL_NUUBOS_PATH/package/libretro/libretro-beetle-pce-fast/Config.in"
source "$BR2_EXTERNAL_NUUBOS_PATH/package/libretro/libretro-fbneo/Config.in"
source "$BR2_EXTERNAL_NUUBOS_PATH/package/libretro/libretro-beetle-ngp/Config.in"
source "$BR2_EXTERNAL_NUUBOS_PATH/package/libretro/libretro-beetle-wswan/Config.in"
source "$BR2_EXTERNAL_NUUBOS_PATH/package/libretro/libretro-beetle-vb/Config.in"
source "$BR2_EXTERNAL_NUUBOS_PATH/package/libretro/libretro-handy/Config.in"
source "$BR2_EXTERNAL_NUUBOS_PATH/package/libretro/libretro-stella2014/Config.in"
source "$BR2_EXTERNAL_NUUBOS_PATH/package/libretro/libretro-fake08/Config.in"
source "$BR2_EXTERNAL_NUUBOS_PATH/package/libretro/libretro-mupen64plus-next/Config.in"
source "$BR2_EXTERNAL_NUUBOS_PATH/package/libretro/libretro-melonds/Config.in"
source "$BR2_EXTERNAL_NUUBOS_PATH/package/libretro/libretro-yabasanshiro/Config.in"
source "$BR2_EXTERNAL_NUUBOS_PATH/package/libretro/libretro-vice/Config.in"
source "$BR2_EXTERNAL_NUUBOS_PATH/package/libretro/libretro-puae/Config.in"
source "$BR2_EXTERNAL_NUUBOS_PATH/package/libretro/libretro-dosbox-pure/Config.in"
source "$BR2_EXTERNAL_NUUBOS_PATH/package/libretro/libretro-scummvm/Config.in"
source "$BR2_EXTERNAL_NUUBOS_PATH/package/libretro/libretro-ppsspp/Config.in"
source "$BR2_EXTERNAL_NUUBOS_PATH/package/libretro/libretro-flycast/Config.in"
source "$BR2_EXTERNAL_NUUBOS_PATH/package/libretro/libretro-cap32/Config.in"
source "$BR2_EXTERNAL_NUUBOS_PATH/package/libretro/libretro-a5200/Config.in"
source "$BR2_EXTERNAL_NUUBOS_PATH/package/libretro/libretro-prosystem/Config.in"
source "$BR2_EXTERNAL_NUUBOS_PATH/package/libretro/libretro-atari800/Config.in"
source "$BR2_EXTERNAL_NUUBOS_PATH/package/libretro/libretro-hatari/Config.in"
source "$BR2_EXTERNAL_NUUBOS_PATH/package/libretro/libretro-freechaf/Config.in"
source "$BR2_EXTERNAL_NUUBOS_PATH/package/libretro/libretro-gearcoleco/Config.in"
source "$BR2_EXTERNAL_NUUBOS_PATH/package/libretro/libretro-potator/Config.in"
source "$BR2_EXTERNAL_NUUBOS_PATH/package/libretro/libretro-sameduck/Config.in"
source "$BR2_EXTERNAL_NUUBOS_PATH/package/libretro/libretro-geolith/Config.in"
source "$BR2_EXTERNAL_NUUBOS_PATH/package/libretro/libretro-freeintv/Config.in"
source "$BR2_EXTERNAL_NUUBOS_PATH/package/libretro/libretro-lutro/Config.in"
source "$BR2_EXTERNAL_NUUBOS_PATH/package/libretro/libretro-minivmac/Config.in"
source "$BR2_EXTERNAL_NUUBOS_PATH/package/libretro/libretro-mame2003-plus/Config.in"
source "$BR2_EXTERNAL_NUUBOS_PATH/package/libretro/libretro-bluemsx/Config.in"
source "$BR2_EXTERNAL_NUUBOS_PATH/package/libretro/libretro-neocd/Config.in"
source "$BR2_EXTERNAL_NUUBOS_PATH/package/libretro/libretro-o2em/Config.in"
source "$BR2_EXTERNAL_NUUBOS_PATH/package/libretro/libretro-mu/Config.in"
source "$BR2_EXTERNAL_NUUBOS_PATH/package/libretro/libretro-quasi88/Config.in"
source "$BR2_EXTERNAL_NUUBOS_PATH/package/libretro/libretro-np2kai/Config.in"
source "$BR2_EXTERNAL_NUUBOS_PATH/package/libretro/libretro-pokemini/Config.in"
source "$BR2_EXTERNAL_NUUBOS_PATH/package/libretro/libretro-simcoupe/Config.in"
source "$BR2_EXTERNAL_NUUBOS_PATH/package/libretro/libretro-vecx/Config.in"
source "$BR2_EXTERNAL_NUUBOS_PATH/package/libretro/libretro-xmil/Config.in"
source "$BR2_EXTERNAL_NUUBOS_PATH/package/libretro/libretro-px68k/Config.in"
source "$BR2_EXTERNAL_NUUBOS_PATH/package/libretro/libretro-fuse/Config.in"
source "$BR2_EXTERNAL_NUUBOS_PATH/package/libretro/emutos/Config.in"
source "$BR2_EXTERNAL_NUUBOS_PATH/package/libretro/libretro-tic80/Config.in"
source "$BR2_EXTERNAL_NUUBOS_PATH/package/libretro/libretro-mame/Config.in"

endmenu
```

## package/libretro/emutos/Config.in
```kconfig
config BR2_PACKAGE_EMUTOS
	bool "emutos"
	help
	  EmuTOS, free Atari ST operating system ROM for Hatari.
```

## package/libretro/libretro-a5200/Config.in
```kconfig
config BR2_PACKAGE_LIBRETRO_A5200
	bool "libretro-a5200"
	depends on BR2_PACKAGE_RETROARCH
	help
	  libretro core: a5200 (Atari 5200).
```

## package/libretro/libretro-atari800/Config.in
```kconfig
config BR2_PACKAGE_LIBRETRO_ATARI800
	bool "libretro-atari800"
	depends on BR2_PACKAGE_RETROARCH
	help
	  libretro core: Atari800 (Atari 400/800/XL/XE/5200).
```

## package/libretro/libretro-beetle-ngp/Config.in
```kconfig
config BR2_PACKAGE_LIBRETRO_BEETLE_NGP
	bool "libretro-beetle-ngp"
	depends on BR2_PACKAGE_RETROARCH
	help
	  libretro core: Beetle NeoPop (Neo Geo Pocket / Color).
```

## package/libretro/libretro-beetle-pce-fast/Config.in
```kconfig
config BR2_PACKAGE_LIBRETRO_BEETLE_PCE_FAST
	bool "libretro-beetle-pce-fast"
	depends on BR2_PACKAGE_RETROARCH
	help
	  libretro core: Beetle PCE Fast (PC Engine / TurboGrafx-16 / CD).
```

## package/libretro/libretro-beetle-vb/Config.in
```kconfig
config BR2_PACKAGE_LIBRETRO_BEETLE_VB
	bool "libretro-beetle-vb"
	depends on BR2_PACKAGE_RETROARCH
	help
	  libretro core: Beetle VB (Virtual Boy).
```

## package/libretro/libretro-beetle-wswan/Config.in
```kconfig
config BR2_PACKAGE_LIBRETRO_BEETLE_WSWAN
	bool "libretro-beetle-wswan"
	depends on BR2_PACKAGE_RETROARCH
	help
	  libretro core: Beetle Cygne (WonderSwan / Color).
```

## package/libretro/libretro-bluemsx/Config.in
```kconfig
config BR2_PACKAGE_LIBRETRO_BLUEMSX
	bool "libretro-bluemsx"
	depends on BR2_PACKAGE_RETROARCH
	help
	  libretro core: blueMSX (MSX/MSX2/MSX2+/turboR, SVI, ColecoVision), with C-BIOS.
```

## package/libretro/libretro-cap32/Config.in
```kconfig
config BR2_PACKAGE_LIBRETRO_CAP32
	bool "libretro-cap32"
	depends on BR2_PACKAGE_RETROARCH
	help
	  libretro core: Caprice32 (Amstrad CPC).
```

## package/libretro/libretro-core-info/Config.in
```kconfig
config BR2_PACKAGE_LIBRETRO_CORE_INFO
	bool "libretro-core-info"
	depends on BR2_PACKAGE_RETROARCH
	help
	  libretro core information files (*.info) for every core, so
	  RetroArch can describe bundled cores and the ones a user
	  downloads with the Online Updater (firmware list, display
	  name, supported extensions).
```

## package/libretro/libretro-dosbox-pure/Config.in
```kconfig
config BR2_PACKAGE_LIBRETRO_DOSBOX_PURE
	bool "libretro-dosbox-pure"
	depends on BR2_PACKAGE_RETROARCH
	help
	  libretro core: DOSBox Pure (MS-DOS).
```
