## package/libretro/libretro-fake08/Config.in
```kconfig
config BR2_PACKAGE_LIBRETRO_FAKE08
	bool "libretro-fake08"
	depends on BR2_PACKAGE_RETROARCH
	help
	  libretro core: FAKE-08 (PICO-8 compatible).
```

## package/libretro/libretro-fbneo/Config.in
```kconfig
config BR2_PACKAGE_LIBRETRO_FBNEO
	bool "libretro-fbneo"
	depends on BR2_PACKAGE_RETROARCH
	help
	  libretro core: FinalBurn Neo (Arcade / Neo Geo). Licence restricts commercial redistribution.
```

## package/libretro/libretro-fceumm/Config.in
```kconfig
config BR2_PACKAGE_LIBRETRO_FCEUMM
	bool "libretro-fceumm"
	depends on BR2_PACKAGE_RETROARCH
	help
	  libretro core: FCEUmm (NES / Famicom / FDS).
```

## package/libretro/libretro-flycast/Config.in
```kconfig
config BR2_PACKAGE_LIBRETRO_FLYCAST
	bool "libretro-flycast"
	depends on BR2_PACKAGE_RETROARCH
	help
	  libretro core: Flycast (Sega Dreamcast / NAOMI).
```

## package/libretro/libretro-freechaf/Config.in
```kconfig
config BR2_PACKAGE_LIBRETRO_FREECHAF
	bool "libretro-freechaf"
	depends on BR2_PACKAGE_RETROARCH
	help
	  libretro core: FreeChaF (Fairchild Channel F).
```

## package/libretro/libretro-freeintv/Config.in
```kconfig
config BR2_PACKAGE_LIBRETRO_FREEINTV
	bool "libretro-freeintv"
	depends on BR2_PACKAGE_RETROARCH
	help
	  libretro core: FreeIntv (Mattel Intellivision).
```

## package/libretro/libretro-fuse/Config.in
```kconfig
config BR2_PACKAGE_LIBRETRO_FUSE
	bool "libretro-fuse"
	depends on BR2_PACKAGE_RETROARCH
	help
	  libretro core: Fuse (Sinclair ZX Spectrum).
```

## package/libretro/libretro-gambatte/Config.in
```kconfig
config BR2_PACKAGE_LIBRETRO_GAMBATTE
	bool "libretro-gambatte"
	depends on BR2_PACKAGE_RETROARCH
	help
	  libretro core: Gambatte (Game Boy / Game Boy Color).
```

## package/libretro/libretro-gearcoleco/Config.in
```kconfig
config BR2_PACKAGE_LIBRETRO_GEARCOLECO
	bool "libretro-gearcoleco"
	depends on BR2_PACKAGE_RETROARCH
	help
	  libretro core: Gearcoleco (ColecoVision).
```

## package/libretro/libretro-genesis-plus-gx/Config.in
```kconfig
config BR2_PACKAGE_LIBRETRO_GENESIS_PLUS_GX
	bool "libretro-genesis-plus-gx"
	depends on BR2_PACKAGE_RETROARCH
	help
	  libretro core: Genesis Plus GX (Master System / Game Gear / Mega Drive / Mega-CD). Licence restricts commercial redistribution.
```

## package/libretro/libretro-geolith/Config.in
```kconfig
config BR2_PACKAGE_LIBRETRO_GEOLITH
	bool "libretro-geolith"
	depends on BR2_PACKAGE_RETROARCH
	help
	  libretro core: Geolith (Neo Geo AES/MVS).
```
