## package/libretro/libretro-handy/Config.in
```kconfig
config BR2_PACKAGE_LIBRETRO_HANDY
	bool "libretro-handy"
	depends on BR2_PACKAGE_RETROARCH
	help
	  libretro core: Handy (Atari Lynx).
```

## package/libretro/libretro-hatari/Config.in
```kconfig
config BR2_PACKAGE_LIBRETRO_HATARI
	bool "libretro-hatari"
	depends on BR2_PACKAGE_RETROARCH
	help
	  libretro core: Hatari (Atari ST/STE/TT/Falcon).
```

## package/libretro/libretro-lutro/Config.in
```kconfig
config BR2_PACKAGE_LIBRETRO_LUTRO
	bool "libretro-lutro"
	depends on BR2_PACKAGE_RETROARCH
	help
	  libretro core: Lutro (Lua game framework).
```

## package/libretro/libretro-mame/Config.in
```kconfig
config BR2_PACKAGE_LIBRETRO_MAME
	bool "libretro-mame"
	depends on BR2_PACKAGE_RETROARCH
	help
	  libretro core: current MAME, reduced to computers/consoles without
	  another core in nuubOS.
```

## package/libretro/libretro-mame2003-plus/Config.in
```kconfig
config BR2_PACKAGE_LIBRETRO_MAME2003_PLUS
	bool "libretro-mame2003-plus"
	depends on BR2_PACKAGE_RETROARCH
	help
	  libretro core: MAME 2003-Plus (arcade, MAME 0.78 sets).
```

## package/libretro/libretro-melonds/Config.in
```kconfig
config BR2_PACKAGE_LIBRETRO_MELONDS
	bool "libretro-melonds"
	depends on BR2_PACKAGE_RETROARCH
	help
	  libretro core: melonDS (Nintendo DS), aarch64 JIT.
```

## package/libretro/libretro-mgba/Config.in
```kconfig
config BR2_PACKAGE_LIBRETRO_MGBA
	bool "libretro-mgba"
	depends on BR2_PACKAGE_RETROARCH
	help
	  libretro core: mGBA (Game Boy Advance).
```

## package/libretro/libretro-minivmac/Config.in
```kconfig
config BR2_PACKAGE_LIBRETRO_MINIVMAC
	bool "libretro-minivmac"
	depends on BR2_PACKAGE_RETROARCH
	help
	  libretro core: Mini vMac (Apple Macintosh Plus/II).
```

## package/libretro/libretro-mu/Config.in
```kconfig
config BR2_PACKAGE_LIBRETRO_MU
	bool "libretro-mu"
	depends on BR2_PACKAGE_RETROARCH
	help
	  libretro core: Mu (Palm OS PDAs).
```

## package/libretro/libretro-mupen64plus-next/Config.in
```kconfig
config BR2_PACKAGE_LIBRETRO_MUPEN64PLUS_NEXT
	bool "libretro-mupen64plus-next"
	depends on BR2_PACKAGE_RETROARCH
	help
	  libretro core: Mupen64Plus-Next (Nintendo 64), aarch64 dynarec + GLideN64 on GLES3.
```

## package/libretro/libretro-neocd/Config.in
```kconfig
config BR2_PACKAGE_LIBRETRO_NEOCD
	bool "libretro-neocd"
	depends on BR2_PACKAGE_RETROARCH
	help
	  libretro core: NeoCD (Neo Geo CD).
```

## package/libretro/libretro-np2kai/Config.in
```kconfig
config BR2_PACKAGE_LIBRETRO_NP2KAI
	bool "libretro-np2kai"
	depends on BR2_PACKAGE_RETROARCH
	help
	  libretro core: Neko Project II kai (NEC PC-9801).
```

## package/libretro/libretro-o2em/Config.in
```kconfig
config BR2_PACKAGE_LIBRETRO_O2EM
	bool "libretro-o2em"
	depends on BR2_PACKAGE_RETROARCH
	help
	  libretro core: O2EM (Magnavox Odyssey² / Videopac).
```

## package/libretro/libretro-parallel-n64/Config.in
```kconfig
config BR2_PACKAGE_LIBRETRO_PARALLEL_N64
	bool "libretro-parallel-n64"
	depends on BR2_PACKAGE_RETROARCH
	help
	  libretro core: ParaLLEl N64 (Nintendo 64), aarch64 dynarec with the
	  GLES3 gln64 / Glide64 / Rice renderers (no Vulkan).
```

## package/libretro/libretro-pcsx-rearmed/Config.in
```kconfig
config BR2_PACKAGE_LIBRETRO_PCSX_REARMED
	bool "libretro-pcsx-rearmed"
	depends on BR2_PACKAGE_RETROARCH
	help
	  libretro core: PCSX ReARMed (PlayStation), ARM64 dynarec + NEON GPU.
```

## package/libretro/libretro-picodrive/Config.in
```kconfig
config BR2_PACKAGE_LIBRETRO_PICODRIVE
	bool "libretro-picodrive"
	depends on BR2_PACKAGE_RETROARCH
	help
	  libretro core: PicoDrive (Sega 32X), ARM64 dynarec. Licence restricts commercial redistribution.
```

## package/libretro/libretro-pokemini/Config.in
```kconfig
config BR2_PACKAGE_LIBRETRO_POKEMINI
	bool "libretro-pokemini"
	depends on BR2_PACKAGE_RETROARCH
	help
	  libretro core: PokeMini (Pokémon Mini).
```

## package/libretro/libretro-potator/Config.in
```kconfig
config BR2_PACKAGE_LIBRETRO_POTATOR
	bool "libretro-potator"
	depends on BR2_PACKAGE_RETROARCH
	help
	  libretro core: Potator (Watara Supervision).
```

## package/libretro/libretro-ppsspp/Config.in
```kconfig
config BR2_PACKAGE_LIBRETRO_PPSSPP
	bool "libretro-ppsspp"
	depends on BR2_PACKAGE_RETROARCH
	help
	  libretro core: PPSSPP (PlayStation Portable).
```

## package/libretro/libretro-prosystem/Config.in
```kconfig
config BR2_PACKAGE_LIBRETRO_PROSYSTEM
	bool "libretro-prosystem"
	depends on BR2_PACKAGE_RETROARCH
	help
	  libretro core: ProSystem (Atari 7800).
```

## package/libretro/libretro-puae/Config.in
```kconfig
config BR2_PACKAGE_LIBRETRO_PUAE
	bool "libretro-puae"
	depends on BR2_PACKAGE_RETROARCH
	help
	  libretro core: PUAE (Commodore Amiga), built-in AROS Kickstart replacement.
```

## package/libretro/libretro-px68k/Config.in
```kconfig
config BR2_PACKAGE_LIBRETRO_PX68K
	bool "libretro-px68k"
	depends on BR2_PACKAGE_RETROARCH
	help
	  libretro core: PX68K (Sharp X68000).
```

## package/libretro/libretro-quasi88/Config.in
```kconfig
config BR2_PACKAGE_LIBRETRO_QUASI88
	bool "libretro-quasi88"
	depends on BR2_PACKAGE_RETROARCH
	help
	  libretro core: QUASI88 (NEC PC-8801).
```

## package/libretro/libretro-sameduck/Config.in
```kconfig
config BR2_PACKAGE_LIBRETRO_SAMEDUCK
	bool "libretro-sameduck"
	depends on BR2_PACKAGE_RETROARCH
	help
	  libretro core: SameDuck (Mega Duck).
```

## package/libretro/libretro-scummvm/Config.in
```kconfig
config BR2_PACKAGE_LIBRETRO_SCUMMVM
	bool "libretro-scummvm"
	depends on BR2_PACKAGE_RETROARCH
	help
	  libretro core: ScummVM (point-and-click adventures).
```
