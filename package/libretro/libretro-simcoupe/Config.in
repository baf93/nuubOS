## package/libretro/libretro-simcoupe/Config.in
```kconfig
config BR2_PACKAGE_LIBRETRO_SIMCOUPE
	bool "libretro-simcoupe"
	depends on BR2_PACKAGE_RETROARCH
	help
	  libretro core: SimCoupe (SAM Coupé).
```

## package/libretro/libretro-snes9x/Config.in
```kconfig
config BR2_PACKAGE_LIBRETRO_SNES9X
	bool "libretro-snes9x"
	depends on BR2_PACKAGE_RETROARCH
	help
	  libretro core: Snes9x (Super Nintendo). Licence restricts commercial redistribution.
```

## package/libretro/libretro-stella2014/Config.in
```kconfig
config BR2_PACKAGE_LIBRETRO_STELLA2014
	bool "libretro-stella2014"
	depends on BR2_PACKAGE_RETROARCH
	help
	  libretro core: Stella 2014 (Atari 2600).
```

## package/libretro/libretro-tic80/Config.in
```kconfig
config BR2_PACKAGE_LIBRETRO_TIC80
	bool "libretro-tic80"
	depends on BR2_PACKAGE_RETROARCH
	help
	  libretro core: TIC-80 fantasy console.
```

## package/libretro/libretro-vice/Config.in
```kconfig
config BR2_PACKAGE_LIBRETRO_VICE
	bool "libretro-vice"
	depends on BR2_PACKAGE_RETROARCH
	help
	  libretro core: VICE x64 (Commodore 64).
```

## package/libretro/libretro-xmil/Config.in
```kconfig
config BR2_PACKAGE_LIBRETRO_XMIL
	bool "libretro-xmil"
	depends on BR2_PACKAGE_RETROARCH
	help
	  libretro core: X Millennium (Sharp X1).
```

## package/libretro/libretro-yabasanshiro/Config.in
```kconfig
config BR2_PACKAGE_LIBRETRO_YABASANSHIRO
	bool "libretro-yabasanshiro"
	depends on BR2_PACKAGE_RETROARCH
	help
	  libretro core: YabaSanshiro (Sega Saturn), aarch64 dynarec + GLES3.
```

## package/libretro/retroarch-assets/Config.in
```kconfig
config BR2_PACKAGE_RETROARCH_ASSETS
	bool "retroarch-assets"
	depends on BR2_PACKAGE_RETROARCH
	help
	  The subset of libretro/retroarch-assets needed by the Ozone
	  menu (RetroArch Advanced): Ozone icons/fonts, XMB monochrome
	  content icons and the western fallback/OSD fonts. CC-BY-4.0.
```

## package/libretro/retroarch/Config.in
```kconfig
config BR2_PACKAGE_RETROARCH
	bool "retroarch"
	depends on BR2_INSTALL_LIBSTDCPP
	depends on BR2_TOOLCHAIN_HAS_THREADS
	depends on BR2_PACKAGE_HAS_LIBEGL
	depends on BR2_PACKAGE_HAS_LIBGLES
	depends on BR2_PACKAGE_WAYLAND
	select BR2_PACKAGE_ALSA_LIB
	select BR2_PACKAGE_FREETYPE
	select BR2_PACKAGE_LIBXKBCOMMON
	select BR2_PACKAGE_WAYLAND_PROTOCOLS
	select BR2_PACKAGE_ZLIB
	help
	  RetroArch, the libretro frontend used by nuubOS as its
	  emulation backend (EPIC-013). Built for Wayland + EGL/GLES
	  (Mesa Panfrost), udev joypads, ALSA/PipeWire audio and the
	  stdin command interface driven by nuubos-emud. No X11, SDL,
	  Vulkan, FFmpeg, Qt or network command interface.

	  https://www.retroarch.com
```

## package/nuubos/labwc/Config.in
```kconfig
config BR2_PACKAGE_LABWC
    bool "labwc"
    depends on BR2_PACKAGE_WAYLAND
    depends on BR2_PACKAGE_WLROOTS
    depends on BR2_TOOLCHAIN_HAS_THREADS
    depends on BR2_USE_WCHAR
    select BR2_PACKAGE_CAIRO
    select BR2_PACKAGE_LIBXML2
    select BR2_PACKAGE_PANGO
    select BR2_PACKAGE_XKEYBOARD_CONFIG
	select BR2_PACKAGE_LIBPNG
	select BR2_PACKAGE_CAIRO_PNG
    help
      A wayland stacking compositor built on wlroots.

comment "labwc needs a toolchain w/ wchar, threads, wayland and wlroots"
    depends on !BR2_PACKAGE_LABWC
```

## package/nuubos/nuubos-audio/Config.in
```kconfig
config BR2_PACKAGE_NUUBOS_AUDIO
	bool "nuubOS audio routing service"
	select BR2_PACKAGE_NUUBOS_NOTIFY
	select BR2_PACKAGE_ALSA_LIB
	select BR2_PACKAGE_DBUS
	select BR2_PACKAGE_MPG123
	help
	  nuubOS platform audio policy service.

	  Provides automatic and manual audio output selection,
	  per-output volume state, runtime status and the frontend
	  nuubos-audioctl interface.
```

## package/nuubos/nuubos-bluetooth/Config.in
```kconfig
config BR2_PACKAGE_NUUBOS_BLUETOOTH
	bool "nuubOS Bluetooth product service"
	select BR2_PACKAGE_NUUBOS_NOTIFY
	select BR2_PACKAGE_DBUS
	select BR2_PACKAGE_BLUEZ5_UTILS
	help
	  Event-driven product service exposing normalized Bluetooth adapter
	  and device state over org.nuubOS.Bluetooth without leaking BlueZ
	  implementation details into nuubUI.
```

## package/nuubos/nuubos-controllers/Config.in
```kconfig
config BR2_PACKAGE_NUUBOS_CONTROLLERS
	bool "nuubOS Controllers product service"
	select BR2_PACKAGE_NUUBOS_NOTIFY
	depends on BR2_PACKAGE_DBUS
	select BR2_PACKAGE_NUUBOS_INPUT
	help
	  User-scoped controller inventory, preferred/effective player assignment,
	  per-controller mappings and live input tester Product API.
```

## package/nuubos/nuubos-displayd/Config.in
```kconfig
config BR2_PACKAGE_NUUBOS_DISPLAYD
	bool "nuubOS display hotplug service"
	select BR2_PACKAGE_LIBDRM
	help
	  nuubOS display hotplug policy service.

	  Tracks DRM hotplug events directly through the kernel uevent
	  netlink interface. Display routing and audio policy are applied
	  by the service without requiring udev or polling.
```

## package/nuubos/nuubos-emulation/Config.in
```kconfig
config BR2_PACKAGE_NUUBOS_EMULATION
	bool "nuubOS emulation service"
	depends on BR2_INSTALL_LIBSTDCPP # retroarch
	depends on BR2_TOOLCHAIN_HAS_THREADS # retroarch
	depends on BR2_PACKAGE_HAS_LIBEGL # retroarch
	depends on BR2_PACKAGE_HAS_LIBGLES # retroarch
	depends on BR2_PACKAGE_WAYLAND # retroarch
	select BR2_PACKAGE_NUUBOS_NOTIFY
	select BR2_PACKAGE_NUUBOS_LIBRARY
	select BR2_PACKAGE_RETROARCH
	select BR2_PACKAGE_RETROARCH_ASSETS
	select BR2_PACKAGE_LIBRETRO_CORE_INFO
	# Default core matrix qualified for H700 (cores.conf). Other
	# cores can be downloaded by the user from RetroArch.
	select BR2_PACKAGE_LIBRETRO_FCEUMM
	select BR2_PACKAGE_LIBRETRO_SNES9X
	select BR2_PACKAGE_LIBRETRO_GAMBATTE
	select BR2_PACKAGE_LIBRETRO_MGBA
	select BR2_PACKAGE_LIBRETRO_PCSX_REARMED
	select BR2_PACKAGE_LIBRETRO_GENESIS_PLUS_GX
	select BR2_PACKAGE_LIBRETRO_PICODRIVE
	select BR2_PACKAGE_LIBRETRO_BEETLE_PCE_FAST
	select BR2_PACKAGE_LIBRETRO_FBNEO
	select BR2_PACKAGE_LIBRETRO_BEETLE_NGP
	select BR2_PACKAGE_LIBRETRO_BEETLE_WSWAN
	select BR2_PACKAGE_LIBRETRO_BEETLE_VB
	select BR2_PACKAGE_LIBRETRO_HANDY
	select BR2_PACKAGE_LIBRETRO_STELLA2014
	select BR2_PACKAGE_LIBRETRO_FAKE08
	# Demanding systems: part of their library runs on H700.
	select BR2_PACKAGE_LIBRETRO_MUPEN64PLUS_NEXT
	select BR2_PACKAGE_LIBRETRO_MELONDS
	select BR2_PACKAGE_LIBRETRO_YABASANSHIRO
	select BR2_PACKAGE_LIBRETRO_FLYCAST
	select BR2_PACKAGE_LIBRETRO_PPSSPP
	# Computers and engines.
	select BR2_PACKAGE_LIBRETRO_VICE
	select BR2_PACKAGE_LIBRETRO_PUAE
	select BR2_PACKAGE_LIBRETRO_SCUMMVM
	select BR2_PACKAGE_LIBRETRO_DOSBOX_PURE
	# Further consoles, computers and handhelds.
	select BR2_PACKAGE_LIBRETRO_CAP32
	select BR2_PACKAGE_LIBRETRO_A5200
	select BR2_PACKAGE_LIBRETRO_PROSYSTEM
	select BR2_PACKAGE_LIBRETRO_ATARI800
	select BR2_PACKAGE_LIBRETRO_HATARI
	select BR2_PACKAGE_EMUTOS
	select BR2_PACKAGE_LIBRETRO_FREECHAF
	select BR2_PACKAGE_LIBRETRO_GEARCOLECO
	select BR2_PACKAGE_LIBRETRO_POTATOR
	select BR2_PACKAGE_LIBRETRO_SAMEDUCK
	select BR2_PACKAGE_LIBRETRO_GEOLITH
	select BR2_PACKAGE_LIBRETRO_FREEINTV
	select BR2_PACKAGE_LIBRETRO_LUTRO
	select BR2_PACKAGE_LIBRETRO_MINIVMAC
	select BR2_PACKAGE_LIBRETRO_MAME2003_PLUS
	select BR2_PACKAGE_LIBRETRO_BLUEMSX
	select BR2_PACKAGE_LIBRETRO_NEOCD
	select BR2_PACKAGE_LIBRETRO_O2EM
	select BR2_PACKAGE_LIBRETRO_MU
	select BR2_PACKAGE_LIBRETRO_QUASI88
	select BR2_PACKAGE_LIBRETRO_NP2KAI
	select BR2_PACKAGE_LIBRETRO_POKEMINI
	select BR2_PACKAGE_LIBRETRO_SIMCOUPE
	select BR2_PACKAGE_LIBRETRO_VECX
	select BR2_PACKAGE_LIBRETRO_XMIL
	select BR2_PACKAGE_LIBRETRO_PX68K
	select BR2_PACKAGE_LIBRETRO_FUSE
	select BR2_PACKAGE_LIBRETRO_TIC80
	select BR2_PACKAGE_LIBRETRO_MAME
	help
	  Emulation service (EPIC-013, EPIC-019, EPIC-020): launches
	  Library games in RetroArch with nuubOS-managed per-user
	  configuration, owns the running game session (pause, save/load
	  state, slots, reset, quit, RetroArch Advanced) and reports
	  sessions to the Game Library.
```

## package/nuubos/nuubos-files/Config.in
```kconfig
config BR2_PACKAGE_NUUBOS_FILES
	bool "nuubos-files"
	depends on BR2_USE_MMU
	select BR2_PACKAGE_NUUBOS_JOBS
	help
	  EPIC-031/032/035/036 and USB storage (EPIC-024): File Manager
	  operations (nuubos-filesctl), removable media mount/eject
	  (nuubos-mediactl), SMB network shares (nuubos-sharesctl) and
	  per-user Backup & Restore (nuubos-backupctl), long operations
	  as nuubos-jobd jobs.
```

## package/nuubos/nuubos-home-music/Config.in
```kconfig
config BR2_PACKAGE_NUUBOS_HOME_MUSIC
	bool "nuubOS default Home Music"
	help
	  Default relaxing jazz/lounge Home Music played when the active
	  user has no MP3 files in their own music folder.

	  Tracks by Kevin MacLeod (incompetech.com), licensed under
	  Creative Commons: By Attribution 4.0. Files are redistributed
	  unmodified; see ATTRIBUTION.txt.
```

## package/nuubos/nuubos-input/Config.in
```kconfig
config BR2_PACKAGE_NUUBOS_INPUT
	bool "nuubOS logical input service"
	help
	  Owns semantic controller bindings and publishes logical input actions.
```

## package/nuubos/nuubos-jobs/Config.in
```kconfig
config BR2_PACKAGE_NUUBOS_JOBS
	bool "nuubos-jobs"
	select BR2_PACKAGE_NUUBOS_NOTIFY
	depends on BR2_USE_MMU
	help
	  EPIC-007 Background Jobs: nuubos-jobd runs registered job
	  types (/usr/share/nuubos/jobs/*.job) as low-priority workers,
	  one Live Notification per job, with cancel and explicit retry.
```

## package/nuubos/nuubos-library/Config.in
```kconfig
config BR2_PACKAGE_NUUBOS_LIBRARY
	bool "nuubOS game library service"
	depends on BR2_TOOLCHAIN_HAS_THREADS
	help
	  Game Library / ROM Discovery service (EPIC-011, EPIC-012,
	  EPIC-020 baseline): central system registry, background
	  reconciliation of /userdata/roms into a shared catalog,
	  per-user play history, favorites and collections, and the
	  installed applications registry consumed by Home.
```

## package/nuubos/nuubos-lighting/Config.in
```kconfig
config BR2_PACKAGE_NUUBOS_LIGHTING
	bool "nuubOS user lighting product service"
	depends on BR2_PACKAGE_DBUS
	select BR2_PACKAGE_NUUBOS_RGB
	help
	  Per-user RGB lighting effects and system signals (renders every
	  frame; nuubos-rgbd is the hardware backend).
```

## package/nuubos/nuubos-localization/Config.in
```kconfig
config BR2_PACKAGE_NUUBOS_LOCALIZATION
	bool "nuubos-localization"
	help
	  Event-driven per-user localization preference service for nuubUI.
```

## package/nuubos/nuubos-media/Config.in
```kconfig
config BR2_PACKAGE_NUUBOS_MEDIA
	bool "nuubos-media"
	depends on BR2_USE_MMU
	select BR2_PACKAGE_NUUBOS_NOTIFY
	select BR2_PACKAGE_MPV
	select BR2_PACKAGE_CJSON
	select BR2_PACKAGE_LIBCURL
	help
	  EPIC-027/028: local video and music playback (nuubos-mediad,
	  mpv with Cedrus decoding and per-user resume) and the Jellyfin
	  media server client (nuubos-jellyfinctl).
```

## package/nuubos/nuubos-notify/Config.in
```kconfig
config BR2_PACKAGE_NUUBOS_NOTIFY
	bool "nuubOS notification router"
	help
	  EPIC-006 notification router. Owning services post typed
	  notification events (Toast / Live Notification) through the
	  staging header <nuubos/notify.h>; the Quick Menu overlay
	  subscribes and renders them above any screen or application.
```

## package/nuubos/nuubos-quick-menu/Config.in
```kconfig
config BR2_PACKAGE_NUUBOS_QUICK_MENU
	bool "nuubOS system-wide Quick Menu overlay"
	depends on BR2_PACKAGE_HOST_RUSTC_TARGET_ARCH_SUPPORTS
	select BR2_PACKAGE_HOST_RUSTC
	select BR2_PACKAGE_NUUBOS_INPUT
	select BR2_PACKAGE_NUUBOS_STATUS
	select BR2_PACKAGE_NUUBOS_NOTIFY
	select BR2_PACKAGE_NUUBOS_LOCALIZATION
	select BR2_PACKAGE_NUUBOS_USERS
	select BR2_PACKAGE_NUUBOS_REGIONAL
	select BR2_PACKAGE_CANTARELL
	help
	  Resident Rust + Slint Quick Menu client consuming logical input actions.
```
