## package/nuubos/armhf-runtime/Config.in
```kconfig
config BR2_PACKAGE_ARMHF_RUNTIME
	bool "nuubOS armhf runtime for 32-bit PortMaster games"
	depends on BR2_aarch64
	depends on !BR2_STATIC_LIBS
	help
	  Minimal 32-bit ARM userland for PortMaster ports that still ship an
	  armhf ELF: the ld-linux-armhf.so.3 loader, glibc, libgcc/libstdc++,
	  SDL2, Mesa 25.2.8/Panfrost (EGL, GLESv2, DRI drivers and glvnd vendor
	  file) and their runtime dependencies. Installed under
	  /usr/lib/arm-linux-gnueabihf, which is also how PortMaster detects
	  DEVICE_HAS_ARMHF. Libraries of the other ABI are ignored by each
	  loader, so no LD_LIBRARY_PATH hacks or 32-bit ld.so.cache are needed.
	  Binary provenance and licences: NOTICE.md.
```

## package/nuubos/gl-nuubos-shim/Config.in
```kconfig
config BR2_PACKAGE_GL_NUUBOS_SHIM
	bool "nuubOS Desktop GL -> GLES thin shim"
	depends on !BR2_STATIC_LIBS
	depends on BR2_TOOLCHAIN_HAS_THREADS
	help
	  libgl_nuubos_shim.so translates Desktop OpenGL calls to OpenGL ES 3.x
	  for PortMaster games. It is built for both the native aarch64 ABI
	  (/usr/lib) and armhf (/usr/lib32) and is preloaded by bash-env.sh in
	  game sessions. The armhf build needs the cross compiler installed in
	  nuubos-dev:0.5 (gcc-arm-linux-gnueabihf).
```

## package/nuubos/nuubos-ports/Config.in
```kconfig
config BR2_PACKAGE_NUUBOS_PORTS
	bool "nuubOS ports service (PortMaster)"
	depends on BR2_PACKAGE_WAYLAND # sdl2 wayland
	depends on BR2_PACKAGE_HAS_LIBEGL # sdl2 wayland
	depends on BR2_PACKAGE_HAS_LIBGLES # sdl2 opengles
	depends on BR2_USE_WCHAR # python3
	depends on BR2_TOOLCHAIN_HAS_THREADS # python3, bubblewrap
	depends on BR2_USE_MMU # python3, bubblewrap
	depends on !BR2_STATIC_LIBS # python3
	depends on BR2_INSTALL_LIBSTDCPP # openal
	depends on BR2_TOOLCHAIN_GCC_AT_LEAST_7 # openal
	depends on BR2_TOOLCHAIN_HAS_THREADS_NPTL # openal
	depends on BR2_PACKAGE_OPENAL_ARCH_SUPPORTS # openal
	select BR2_PACKAGE_GL_NUUBOS_SHIM # desktop GL -> GLES preload
	select BR2_PACKAGE_ARMHF_RUNTIME # 32-bit ports (loader + SDL2)
	select BR2_PACKAGE_BASH # port scripts
	select BR2_PACKAGE_ZIP # port scripts that patch their game archive (Mindustry)
	select BR2_PACKAGE_BUBBLEWRAP # sandbox
	select BR2_PACKAGE_PYTHON3 # PortMaster GUI (pugwash)
	select BR2_PACKAGE_PYTHON3_SSL # downloads
	select BR2_PACKAGE_PYTHON3_ZLIB # zip files
	select BR2_PACKAGE_PYTHON3_XZ # tar.xz files
	select BR2_PACKAGE_PYTHON3_BZIP2 # tar.bz2 files
	select BR2_PACKAGE_PYTHON3_PYEXPAT # gamelist XML
	select BR2_PACKAGE_PYTHON3_UNICODEDATA
	select BR2_PACKAGE_SDL2
	select BR2_PACKAGE_SDL2_WAYLAND
	select BR2_PACKAGE_SDL2_OPENGLES
	select BR2_PACKAGE_SDL2_IMAGE
	select BR2_PACKAGE_LIBPNG # sdl2_image png
	select BR2_PACKAGE_JPEG # sdl2_image jpg
	select BR2_PACKAGE_SDL2_TTF
	select BR2_PACKAGE_SDL2_MIXER
	select BR2_PACKAGE_SDL2_GFX
	select BR2_PACKAGE_OPENAL # LOVE runtime, many ports
	select BR2_PACKAGE_LIBVORBIS # LOVE runtime, many ports
	select BR2_PACKAGE_LIBTHEORA # LOVE runtime (liblove needs libtheoradec)
	select BR2_PACKAGE_LIBCURL # PortMaster download
	select BR2_PACKAGE_OPENSSL # PortMaster checksum
	select BR2_PACKAGE_CA_CERTIFICATES # downloads (TLS)
	help
	  Ports (EPIC-058): PortMaster, downloaded on the device and
	  updated by itself, and the ports it installs, each run in a
	  sandbox (bubblewrap) that only sees its own folder. The image
	  holds what PortMaster and the ports expect from the system:
	  bash, zip, Python 3, SDL2 and its image/ttf/mixer/gfx libraries,
	  OpenAL, Vorbis and Theora.
```
