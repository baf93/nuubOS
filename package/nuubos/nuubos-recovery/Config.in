## package/nuubos/nuubos-recovery/Config.in
```kconfig
config BR2_PACKAGE_NUUBOS_RECOVERY
	bool "nuubos-recovery"
	depends on BR2_USE_MMU
	select BR2_PACKAGE_NUUBOS_JOBS
	help
	  EPIC-049/050/052: diagnostics and support bundle (nuubos-diag),
	  scoped reset and repair (nuubos-recoveryctl) and the UI
	  supervisor with crash-loop detection and safe mode.
```

## package/nuubos/nuubos-regional/Config.in
```kconfig
config BR2_PACKAGE_NUUBOS_REGIONAL
	bool "nuubOS regional settings service"
	select BR2_PACKAGE_KBD
	select BR2_TARGET_TZ_INFO
	help
	  Device-global timezone, automatic time synchronization and keyboard layout.
```

## package/nuubos/nuubos-remote/Config.in
```kconfig
config BR2_PACKAGE_NUUBOS_REMOTE
	bool "nuubos-remote"
	depends on BR2_USE_MMU
	select BR2_PACKAGE_DROPBEAR
	select BR2_PACKAGE_KSMBD_TOOLS
	select BR2_PACKAGE_LIGHTTPD
	select BR2_PACKAGE_NUUBOS_LIBRARY
	help
	  EPIC-037/038/039: Remote Services, each disabled by default and
	  switched in Settings: SSH/SCP/SFTP (Dropbear, root + device password),
	  SMB file sharing (kernel ksmbd) and the authenticated Web
	  administration (lighttpd), all with one random
	  per-device credential kept in STATE.
```

## package/nuubos/nuubos-rgb/Config.in
```kconfig
config BR2_PACKAGE_NUUBOS_RGB
	bool "nuubOS RGB lighting service"
	help
	  nuubOS RGB lighting subsystem.

	  Provides device-aware RGB topology, the H700 UART RGB backend,
	  the nuubos-rgbd renderer daemon, and the nuubos-rgbctl client.

	  Devices without RGB capability are handled as a normal,
	  unsupported capability and do not activate RGB hardware.
```

## package/nuubos/nuubos-rumble/Config.in
```kconfig
config BR2_PACKAGE_NUUBOS_RUMBLE
	bool "nuubOS internal rumble product service"
	depends on BR2_PACKAGE_DBUS
	help
	  User-scoped internal rumble policy and test service.
```

## package/nuubos/nuubos-scraper/Config.in
```kconfig
config BR2_PACKAGE_NUUBOS_SCRAPER
	bool "nuubos-scraper"
	depends on BR2_USE_MMU
	select BR2_PACKAGE_NUUBOS_JOBS
	select BR2_PACKAGE_NUUBOS_LIBRARY
	select BR2_PACKAGE_LIBCURL
	select BR2_PACKAGE_CA_CERTIFICATES
	select BR2_PACKAGE_SKYSCRAPER if BR2_PACKAGE_QT6
	help
	  EPIC-015 optional game metadata and media, stored in the
	  provider-neutral Library metadata store. Sources: ScreenScraper
	  and TheGamesDB through Skyscraper (package skyscraper, needs
	  Qt6), libretro thumbnails directly.
```

## package/nuubos/nuubos-sftp-server/Config.in
```kconfig
config BR2_PACKAGE_NUUBOS_SFTP_SERVER
	bool "nuubOS SFTP server helper"
	depends on BR2_USE_MMU
	select BR2_PACKAGE_OPENSSH
	help
	  Install the OpenSSH sftp-server subsystem helper used by the
	  existing Dropbear SSH daemon. nuubOS does not run OpenSSH sshd.
```

## package/nuubos/nuubos-splash/Config.in
```kconfig
config BR2_PACKAGE_NUUBOS_SPLASH
	bool "nuubOS early splash"
	depends on BR2_PACKAGE_LIBDRM
	help
	  Lightweight DRM/KMS splash renderer used during boot,
	  restart and poweroff for the early graphics bring-up.
```

## package/nuubos/nuubos-status/Config.in
```kconfig
config BR2_PACKAGE_NUUBOS_STATUS
	bool "nuubos-status"
	select BR2_PACKAGE_WPA_SUPPLICANT
	select BR2_PACKAGE_WPA_SUPPLICANT_CLI
	select BR2_PACKAGE_BLUEZ5_UTILS
	select BR2_PACKAGE_BLUEZ5_UTILS_CLIENT
	help
	  Event-driven nuubOS topbar status service. It owns the normalized
	  current-user, clock, Wi-Fi, system-battery and connected Bluetooth
	  controller status contract consumed by nuubUI.
```

## package/nuubos/nuubos-streaming/Config.in
```kconfig
config BR2_PACKAGE_NUUBOS_STREAMING
	bool "nuubOS PC game streaming service"
	depends on BR2_TOOLCHAIN_HAS_THREADS # moonlight-embedded
	depends on BR2_PACKAGE_HAS_UDEV # moonlight-embedded
	depends on BR2_PACKAGE_WAYLAND # moonlight-embedded
	depends on BR2_INSTALL_LIBSTDCPP # steamlink-runtime
	depends on BR2_PACKAGE_HAS_LIBEGL # steamlink-runtime
	depends on BR2_PACKAGE_HAS_LIBGLES # steamlink-runtime
	depends on BR2_USE_MMU # steamlink-runtime
	depends on !BR2_STATIC_LIBS # steamlink-runtime
	depends on BR2_PACKAGE_LIBEPOXY # steamlink-runtime
	select BR2_PACKAGE_NUUBOS_NOTIFY
	select BR2_PACKAGE_MOONLIGHT_EMBEDDED
	select BR2_PACKAGE_STEAMLINK_RUNTIME
	select BR2_PACKAGE_LIBCURL # Steam Link download
	select BR2_PACKAGE_ZLIB # Steam Link download
	select BR2_PACKAGE_OPENSSL # Steam Link signature check
	select BR2_PACKAGE_CA_CERTIFICATES # Steam Link download (TLS)
	help
	  PC game streaming service (EPIC-025, EPIC-026): per-user
	  GameStream / Sunshine hosts, pairing, host applications,
	  stream settings and the running Moonlight stream (gamepads,
	  Quick Menu, lifecycle). Moonlight runs as a child process.
	  Steam Link: downloads Valve's application on request and runs
	  it as a session like a stream.
```

## package/nuubos/nuubos-sync/Config.in
```kconfig
config BR2_PACKAGE_NUUBOS_SYNC
	bool "nuubos-sync"
	depends on BR2_USE_MMU
	depends on BR2_PACKAGE_HOST_GO_TARGET_ARCH_SUPPORTS
	select BR2_PACKAGE_SYNCTHING
	select BR2_PACKAGE_CJSON
	select BR2_PACKAGE_LIBCURL
	help
	  EPIC-034: optional per-user Syncthing (saves, save states,
	  screenshots) run for the active user only (nuubos-syncd) and
	  configured through nuubos-syncctl.
```

## package/nuubos/nuubos-system/Config.in
```kconfig
config BR2_PACKAGE_NUUBOS_SYSTEM
	bool "nuubos-system"
	select BR2_PACKAGE_NUUBOS_NOTIFY
	depends on BR2_USE_MMU
	help
	  Product-level System/Power policy and telemetry service for nuubOS.
```

## package/nuubos/nuubos-themes/Config.in
```kconfig
config BR2_PACKAGE_NUUBOS_THEMES
	bool "nuubos-themes"
	help
	  EPIC-008 Themes: nuubos-themectl (validation, install, update,
	  removal and the per-user selection of theme packages) and the
	  built-in themes. Packages hold presentation tokens only.
```

## package/nuubos/nuubos-update/Config.in
```kconfig
config BR2_PACKAGE_NUUBOS_UPDATE
	bool "nuubos-update"
	depends on BR2_USE_MMU
	select BR2_PACKAGE_NUUBOS_JOBS
	select BR2_PACKAGE_LIBCURL
	select BR2_PACKAGE_CA_CERTIFICATES
	select BR2_PACKAGE_LIBSODIUM
	help
	  EPIC-048 OTA updates: signed release manifest (Ed25519, public
	  key from board/nuubos/common/ota/update-key.pub), resumable
	  verified download, installation on the next restart with a
	  rollback of the replaced system files when the new system does
	  not reach nuubUI.
```

## package/nuubos/nuubos-users/Config.in
```kconfig
config BR2_PACKAGE_NUUBOS_USERS
	bool "nuubOS user/profile service"
	help
	  Local console profile/session service: users, active user, boot policy and avatars.
```

## package/nuubos/nuubos-web/Config.in
```kconfig
config BR2_PACKAGE_NUUBOS_WEB
	bool "nuubos-web"
	depends on BR2_PACKAGE_WPEWEBKIT_ARCH_SUPPORTS
	depends on BR2_INSTALL_LIBSTDCPP # wpewebkit
	depends on BR2_PACKAGE_HAS_LIBEGL # wpewebkit
	depends on BR2_PACKAGE_HAS_LIBGLES # wpewebkit
	depends on BR2_TOOLCHAIN_GCC_AT_LEAST_11 # wpewebkit
	depends on BR2_USE_WCHAR # wpewebkit
	depends on BR2_TOOLCHAIN_HAS_THREADS_NPTL # wpewebkit
	depends on !BR2_STATIC_LIBS # wpewebkit
	select BR2_PACKAGE_NUUBOS_NOTIFY
	select BR2_PACKAGE_DBUS
	select BR2_PACKAGE_WPEWEBKIT
	select BR2_PACKAGE_WPEWEBKIT_SANDBOX
	select BR2_PACKAGE_WPEWEBKIT_MULTIMEDIA
	select BR2_PACKAGE_COG
	select BR2_PACKAGE_COG_PLATFORM_FDO
	select BR2_PACKAGE_COG_USE_SYSTEM_DBUS
	select BR2_PACKAGE_GST1_PLUGINS_BAD_PLUGIN_V4L2CODECS # Cedrus
	select BR2_PACKAGE_GST1_PLUGINS_BASE_LIB_OPENGL
	select BR2_PACKAGE_CA_CERTIFICATES # HTTPS
	help
	  EPIC-030 Web Mode: an optional controller-friendly browser.
	  nuubos-webd runs WPE WebKit through Cog (Wayland, GLES,
	  WebKit bubblewrap sandbox) as one session with a per-user
	  profile; nuubos-inputd turns the controller into keyboard and
	  pointer for it and the Quick Menu provides text entry through
	  the Wayland input-method protocol.
```

## package/nuubos/nuubos-wifi/Config.in
```kconfig
config BR2_PACKAGE_NUUBOS_WIFI
	bool "nuubOS Wi-Fi product service"
	select BR2_PACKAGE_NUUBOS_NOTIFY
	select BR2_PACKAGE_DBUS
	select BR2_PACKAGE_WPA_SUPPLICANT
	select BR2_PACKAGE_WPA_SUPPLICANT_CLI
	select BR2_PACKAGE_WPA_SUPPLICANT_WPS
	help
	  Event-driven product service exposing normalized Wi-Fi state over
	  org.nuubOS.Wifi without leaking wpa_supplicant details into nuubUI.
```

## package/nuubos/nuubui-home/Config.in
```kconfig
config BR2_PACKAGE_NUUBUI_HOME
	bool "nuubUI placeholder home"
	depends on BR2_PACKAGE_HOST_RUSTC_TARGET_ARCH_SUPPORTS
	select BR2_PACKAGE_HOST_RUSTC
	select BR2_PACKAGE_LIBDRM
	select BR2_PACKAGE_CANTARELL
	select BR2_PACKAGE_NUUBOS_LOCALIZATION
	select BR2_PACKAGE_NUUBOS_USERS
	select BR2_PACKAGE_NUUBOS_REGIONAL
	select BR2_PACKAGE_NUUBOS_LIBRARY
	help
	  nuubUI placeholder Home implemented in Rust + Slint.
	  Provides the first graphics micro-step with a top bar,
	  center content area and bottom bar.
```

## package/streaming/Config.in
```kconfig
menu "Streaming"

source "$BR2_EXTERNAL_NUUBOS_PATH/package/streaming/moonlight-embedded/Config.in"
source "$BR2_EXTERNAL_NUUBOS_PATH/package/streaming/md4c/Config.in"
source "$BR2_EXTERNAL_NUUBOS_PATH/package/streaming/steamlink-runtime/Config.in"

endmenu
```

## package/streaming/md4c/Config.in
```kconfig
config BR2_PACKAGE_MD4C
	bool "md4c"
	help
	  MD4C is a Markdown parser written in C (CommonMark). Needed
	  at runtime by the Qt 5 libraries bundled with the Valve Steam
	  Link application.

	  https://github.com/mity/md4c
```

## package/streaming/moonlight-embedded/Config.in
```kconfig
config BR2_PACKAGE_MOONLIGHT_EMBEDDED
	bool "moonlight-embedded"
	depends on BR2_TOOLCHAIN_HAS_THREADS
	depends on BR2_PACKAGE_HAS_UDEV
	depends on BR2_PACKAGE_WAYLAND
	select BR2_PACKAGE_ALSA_LIB
	select BR2_PACKAGE_EXPAT
	select BR2_PACKAGE_FFMPEG
	select BR2_PACKAGE_LIBCURL
	select BR2_PACKAGE_LIBDRM
	select BR2_PACKAGE_LIBEVDEV
	select BR2_PACKAGE_OPENSSL
	select BR2_PACKAGE_OPUS
	select BR2_PACKAGE_UTIL_LINUX
	select BR2_PACKAGE_UTIL_LINUX_LIBUUID
	select BR2_PACKAGE_WAYLAND_PROTOCOLS
	help
	  Moonlight Embedded, the C client for NVIDIA GameStream and
	  Sunshine PC game streaming (EPIC-025), with the nuubOS
	  Wayland platform: H.264/HEVC decoded by the VPU through
	  FFmpeg's V4L2 request hwaccel (Cedrus on the H700) and shown
	  as zero-copy dma-bufs, low latency ALSA (PipeWire) audio,
	  nuubOS game gamepads and a control channel for the nuubOS
	  streaming service. No SDL, X11, CEC, PulseAudio or avahi.

	  https://github.com/moonlight-stream/moonlight-embedded
```

## package/streaming/steamlink-runtime/Config.in
```kconfig
config BR2_PACKAGE_STEAMLINK_RUNTIME
	bool "steamlink-runtime"
	depends on BR2_INSTALL_LIBSTDCPP # double-conversion, Qt
	depends on BR2_PACKAGE_HAS_LIBEGL
	depends on BR2_PACKAGE_HAS_LIBGLES
	depends on BR2_PACKAGE_HAS_UDEV # ffmpeg v4l2 request
	depends on BR2_USE_MMU # libkrb5, dbus
	depends on !BR2_STATIC_LIBS
	# Not selected: libepoxy is in a Kconfig cycle with wayland (weston
	# XWayland), and the clients of this package depend on wayland.
	depends on BR2_PACKAGE_LIBEPOXY
	select BR2_PACKAGE_DBUS
	select BR2_PACKAGE_DOUBLE_CONVERSION
	select BR2_PACKAGE_FFMPEG
	select BR2_PACKAGE_FONTCONFIG
	select BR2_PACKAGE_FREETYPE
	select BR2_PACKAGE_HARFBUZZ
	select BR2_PACKAGE_LIBDRM
	select BR2_PACKAGE_LIBGLIB2
	select BR2_PACKAGE_LIBKRB5
	select BR2_PACKAGE_LIBPNG
	select BR2_PACKAGE_LIBXKBCOMMON
	select BR2_PACKAGE_MD4C
	select BR2_PACKAGE_ZLIB
	select BR2_PACKAGE_ZSTD
	help
	  What the Valve Steam Link application (arm64, Raspberry Pi
	  OS build) needs besides the libraries it bundles: FFmpeg 7.1
	  libavcodec/libavutil (H.264/HEVC through the V4L2 request
	  hwaccel), libepoxy, double-conversion, md4c, zstd, the
	  Kerberos GSSAPI library linked by its Qt 5, and the Qt 5.14.1
	  Wayland platform plugin Valve does not ship (built here from
	  Qt sources). The Steam Link application itself is proprietary
	  and is not part of the image: it is downloaded from Valve on
	  the device.
```

## package/thirdparty/skyscraper/Config.in
```kconfig
config BR2_PACKAGE_SKYSCRAPER
	bool "skyscraper"
	depends on BR2_PACKAGE_QT6
	depends on BR2_INSTALL_LIBSTDCPP
	select BR2_PACKAGE_QT6BASE
	select BR2_PACKAGE_QT6BASE_GUI
	select BR2_PACKAGE_QT6BASE_NETWORK
	select BR2_PACKAGE_QT6BASE_SQL
	select BR2_PACKAGE_QT6BASE_XML
	select BR2_PACKAGE_QT6BASE_PNG
	select BR2_PACKAGE_QT6BASE_JPEG
	select BR2_PACKAGE_OPENSSL
	help
	  Skyscraper (Gemba fork), the game data scraper. nuubOS uses it
	  only as the ScreenScraper and TheGamesDB backend of
	  nuubos-scraper (EPIC-015): it runs headless (QCoreApplication)
	  as a single binary with its configuration bundled.

	  https://github.com/Gemba/skyscraper
```

## package/thirdparty/syncthing/Config.in
```kconfig
config BR2_PACKAGE_SYNCTHING
	bool "syncthing"
	depends on BR2_PACKAGE_HOST_GO_TARGET_ARCH_SUPPORTS
	select BR2_PACKAGE_HOST_GO
	help
	  Continuous peer-to-peer file synchronization (EPIC-034), run by
	  nuubos-syncd for the active user only. Built without the
	  self-upgrade feature.

	  https://syncthing.net
```
